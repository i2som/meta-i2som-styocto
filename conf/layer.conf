## conf/layer.conf
```bitbake
# We have a conf and classes directory, add to BBPATH
BBPATH .= ":${LAYERDIR}"

# We have recipes-* directories, add to BBFILES
BBFILES += "${LAYERDIR}/recipes-*/*/*.bb \
            ${LAYERDIR}/recipes-*/*/*.bbappend"

BBFILE_COLLECTIONS += "meta-i2som-styocto"
BBFILE_PATTERN_meta-i2som-styocto = "^${LAYERDIR}/"
BBFILE_PRIORITY_meta-i2som-styocto = "5"

EULA_FILE_ST_pangu = "${LAYERDIR}/conf/eula/${MACHINE}"
EULA_FILE_ST_MD5SUM_pangu = "8b505090fb679839cefbcc784afe8ce9"
LICENSE_PATH += "${LAYERDIR}/files/licenses"

LAYERDEPENDS_meta-i2som-styocto = "core"
LAYERSERIES_COMPAT_meta-i2som-styocto = "thud"
```

## conf/machine/i2cmp15xbe.conf
```bitbake
#@TYPE: Machine
#@NAME: pangu
#@DESCRIPTION: Configuration for PanGu board (Trusted boot and SDcard only)
#@NEEDED_BSPLAYERS:

include conf/machine/include/i2som-machine-common-stm32mp.inc

# =========================================================================
# Chip architecture
# =========================================================================
DEFAULTTUNE = "cortexa7thf-neon-vfpv4"
include conf/machine/include/tune-cortexa7.inc

# =========================================================================
# boot scheme
# =========================================================================
BOOTSCHEME_LABELS += "basic"
BOOTSCHEME_LABELS += "trusted"
#BOOTSCHEME_LABELS += "optee"

# =========================================================================
# Machine settings
# =========================================================================
# Define list of devicetree per board
#STM32MP_DT_FILES_DK += "stm32mp157a-dk1"
#STM32MP_DT_FILES_DK += "stm32mp157c-dk2"
#STM32MP_DT_FILES_ED += "stm32mp157c-ed1"
#STM32MP_DT_FILES_PANGU += "stm32mp157a-panguboard"

# =========================================================================
# Machine features
# =========================================================================
MACHINE_FEATURES += "bluetooth"
MACHINE_FEATURES += "wifi"
MACHINE_FEATURES += "${@'gpu' if d.getVar('ACCEPT_EULA_'+d.getVar('MACHINE')) == '1' else ''}"
#MACHINE_FEATURES += "gpu"
# Splashscreen enabled
MACHINE_FEATURES += "splashscreen"

MACHINE_EXTRA_RRECOMMENDS_append = " kernel-module-rtl8188eu \
	kernel-module-exar \
	firmware-rtl8188eu \
	firmware-gt9147 \
"

# =========================================================================
# Image
# =========================================================================
# Add ubi FSTYPES to default ones for nand volumes
#IMAGE_FSTYPES += "stmultiubi"


ELF_DEBUG_ENABLE = ""
#EXTRA_IMAGEDEPENDS = "tf-a-i2som"
TF_A_DEVICETREE = "stm32mp157a-i2cmp15xbe"

UBOOT_DEVICETREE = "stm32mp157a-i2cmp15xbe"

# =========================================================================
# Kernel
# =========================================================================
# Kernel config
# Set this address to 0xC2000040, which is 0xC2000000 + 0x40.
# 0xC2000000 is the memory address where U-Boot will copy from flash the file uImage and 0x40 is uImage header size (64Bytes).

PREFERRED_PROVIDER_virtual/kernel = "linux-i2som"
ST_KERNEL_LOADADDR   = "0xC2000040"
PANGU_DT_FILES = "stm32mp157a-i2cmp15xbe-lcd043p800c stm32mp157a-i2cmp15xbe-lcd070p1024c"
PANGU_DT_FILE = "stm32mp157a-i2cmp15xbe"
STM32MP_DEVICETREE_append = " ${PANGU_DT_FILES} "

# For eval board: auto-load goodix module (touchscreen module)
KERNEL_MODULE_AUTOLOAD = "goodix"

# Define the devicetree for Linux A7 examples
#LINUX_A7_EXAMPLES_DT += "stm32mp157c-dk2-a7-examples"
#LINUX_A7_EXAMPLES_DT += "stm32mp157c-ev1-a7-examples"

# =========================================================================
# flashlayout
# =========================================================================
# Define the config labels to use to generate flashlayout file
FLASHLAYOUT_CONFIG_LABELS += "emmc"
#FLASHLAYOUT_CONFIG_LABELS += "nand-4-256"
#FLASHLAYOUT_CONFIG_LABELS += "nor-sdcard"
FLASHLAYOUT_CONFIG_LABELS += "nor-emmc"
#FLASHLAYOUT_CONFIG_LABELS += "nor-nand-4-256"
FLASHLAYOUT_CONFIG_LABELS += "sdcard"

# =========================================================================
# M4 copro
# =========================================================================
# Define the devicetree for M4 example
#CUBE_M4_EXAMPLES_DT += "stm32mp157c-dk2-m4-examples"
#CUBE_M4_EXAMPLES_DT += "stm32mp157c-ev1-m4-examples"

# Define specific board reference to m4projects-stm32mp1.bb
#M4_BOARDS = "STM32MP157C-EV1"

# =========================================================================
# extlinux configuration
# =========================================================================
# As example, modify the default boot config for each target to M4 config
#UBOOT_EXTLINUX_DEFAULT_LABEL_pangu_sdcard       = "pangu-sdcard"
```
